## boards/shields/kpd/Kconfig.defconfig
```kconfig
# Copyright (c) 2020 The ZMK Contributors
# SPDX-License-Identifier: MIT

if SHIELD_KPD

config ZMK_KEYBOARD_NAME
	default "KPD"

endif
```

## boards/shields/kpd/Kconfig.shield
```kconfig
# Copyright (c) 2020 The ZMK Contributors
# SPDX-License-Identifier: MIT

config SHIELD_KPD
	def_bool $(shields_list_contains,kpd)
```
