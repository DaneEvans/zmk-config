
#include "narfpad.dtsi"

/ {
    chosen {
        zmk,kscan = &kscan0;
    };

    kscan0: kscan_0 {
        compatible = "zmk,kscan-gpio-matrix";
        diode-direction = "col2row";
        label = "KSCAN";
        wakeup-source;

        left_encoder: encoder_left {
            compatible = "alps,ec11";
            a-gpios = <&xiao_d 1 (GPIO_ACTIVE_HIGH | GPIO_PULL_UP)>;
            b-gpios = <&xiao_d 2 (GPIO_ACTIVE_HIGH | GPIO_PULL_UP)>;
            steps = <80>;
            status = "disabled";
        };


        col-gpios
            = <&xiao_d 29 GPIO_ACTIVE_HIGH>
            , <&xiao_d 28 GPIO_ACTIVE_HIGH>
            , <&xiao_d 27 GPIO_ACTIVE_HIGH>
            ;

        row-gpios
            = <&xiao_d 6 (GPIO_ACTIVE_HIGH | GPIO_PULL_DOWN)>
            , <&xiao_d 7 (GPIO_ACTIVE_HIGH | GPIO_PULL_DOWN)>
            , <&xiao_d 0 (GPIO_ACTIVE_HIGH | GPIO_PULL_DOWN)>
            ;
    };
};

&left_encoder {
    status = "okay";
};


